## firmware/Kconfig.projbuild
```kconfig
menu "EchoPose Configuration"

    config WIFI_SSID
        string "Wi-Fi SSID"
        default "EchoPose_MESH"
        help
            SSID of the 2.4GHz Wi-Fi Access Point to connect to.

    config WIFI_PASSWORD
        string "Wi-Fi Password"
        default "echopose123"
        help
            Password for the Wi-Fi AP.

    config NODE_ID
        int "Node ID"
        default 0
        range 0 10
        help
            Unique ID for this node (0=Transmitter, 1-10=Receivers).

    config HOST_IP
        string "Aggregator Host IP"
        default "192.168.1.100"
        help
            IP address of the machine running the Rust Aggregator.

    config HOST_PORT
        int "Aggregator Host UDP Port"
        default 5005
        help
            UDP port the aggregator is listening on.

endmenu
```

## firmware/sdkconfig.defaults
```kconfig
# Default sdkconfig values — override in menuconfig or CI
CONFIG_WIFI_SSID="Pixel_4719"
CONFIG_WIFI_PASSWORD="uusu2026"
CONFIG_NODE_ID=2
CONFIG_HOST_IP="10.36.85.210"
CONFIG_HOST_PORT=5005

# Power & performance
CONFIG_ESP32S3_DEFAULT_CPU_FREQ_240=y
CONFIG_FREERTOS_HZ=1000
CONFIG_ESP_WIFI_CSI_ENABLED=y

# Disable power save for lowest latency
CONFIG_PM_ENABLE=n
CONFIG_ESP_WIFI_STA_DISCONNECTED_PM_ENABLE=n

# OTA
CONFIG_ESP_HTTPS_OTA_ALLOW_HTTP=y
```
